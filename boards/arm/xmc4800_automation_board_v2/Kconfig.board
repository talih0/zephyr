## boards/arm/xmc4800_automation_board_v2/Kconfig.board
```kconfig
# SPDX-License-Identifier: Apache-2.0
#
# Copyright (c) 2022 Andriy Gelman <andriy.gelman@gmail.com>

config BOARD_XMC4800_AUTOMATION_V2
	bool "XMC4800 Automation board"
	depends on SOC_SERIES_XMC_4XXX
	select SOC_PART_NUMBER_E196X2048
```

## boards/arm/xmc4800_automation_board_v2/Kconfig.defconfig
```kconfig
# SPDX-License-Identifier: Apache-2.0
#
# Copyright (c) 2022 Andriy Gelman <andriy.gelman@gmail.com>

if BOARD_XMC4800_AUTOMATION_V2

config BOARD
	default "xmc4800_automation_board_v2"

endif
```

## samples/drivers/can/counter/boards/xmc47_relax_kit.conf
```kconfig
CONFIG_CAN_XMC4XXX_MAX_TX_QUEUE=4
CONFIG_CAN_XMC4XXX_INTERNAL_BUS_MODE=y
CONFIG_LOOPBACK_MODE=n
```

## soc/arm/infineon_xmc/Kconfig.defconfig
```kconfig
# SPDX-License-Identifier: Apache-2.0
#
# Copyright (c) 2020 Linumiz
# Author: Parthiban Nallathambi <parthiban@linumiz.com>

source "soc/arm/infineon_xmc/*/Kconfig.defconfig.series"

DT_CHOSEN_Z_FLASH := zephyr,flash

config FLASH_VMA_BASE_ADDRESS
	hex "VMA Flash Base Address"
	default $(dt_chosen_reg_addr_hex,$(DT_CHOSEN_Z_FLASH),1)
	help
		XMC4xxx devices have an cached and uncached flash address space. The cached address space is
		used for reads; The uncached address space is used for erase/write operations. This option
		points to the cached address. The uncached base address remains CONFIG_FLASH_BASE_ADDRESS which
		is the base address for flashing the device.	
```

## tests/drivers/can/api/Kconfig
```kconfig
# Copyright (c) 2023 Andriy Gelman
# SPDX-License-Identifier: Apache-2.0

config LOOPBACK_MODE
	bool "Loopback LOOPBACK_MODE"
	default y
	help
	  Set the controller to loopback mode.
	  This allows testing without a second board.

source "Kconfig.zephyr"
```

## tests/drivers/can/api/boards/xmc47_relax_kit.conf
```kconfig
CONFIG_CAN_XMC4XXX_MAX_TX_QUEUE=1
CONFIG_CAN_XMC4XXX_INTERNAL_BUS_MODE=y
CONFIG_LOOPBACK_MODE=n
```
